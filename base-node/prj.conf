## CMakeLists.txt
```
# SPDX-License-Identifier: Apache-2.0

cmake_minimum_required(VERSION 3.20.0)
find_package(Zephyr REQUIRED HINTS $ENV{ZEPHYR_BASE})
project(zephyrus-green)

FILE(GLOB app_sources src/*.c)

target_sources(app PRIVATE ${app_sources})
```

## prj.conf
```kconfig
CONFIG_NETWORKING=y
CONFIG_NET_TCP=y
CONFIG_NET_UDP=y
CONFIG_NET_IPV4=y
CONFIG_NET_DHCPV4=y
CONFIG_NET_SOCKETS=y
CONFIG_POSIX_API=y

# WiFi
CONFIG_WIFI=y
CONFIG_NET_L2_WIFI_MGMT=y


# System
CONFIG_MAIN_STACK_SIZE=8192
CONFIG_SYSTEM_WORKQUEUE_STACK_SIZE=2048

# Logging
CONFIG_LOG=y
CONFIG_NET_LOG=y


# General Zephyr kernel configuration
CONFIG_HEAP_MEM_POOL_SIZE=16384
CONFIG_MAIN_STACK_SIZE=4096
CONFIG_NEWLIB_LIBC=y
CONFIG_NEWLIB_LIBC_FLOAT_PRINTF=y
CONFIG_CBPRINTF_FP_SUPPORT=y

CONFIG_NET_MGMT=y
CONFIG_NET_MGMT_EVENT=y
CONFIG_NET_MGMT_EVENT_STACK_SIZE=2048

# rtc
CONFIG_RTC=y
CONFIG_RTC_CALIBRATION=y


CONFIG_NET_PKT_RX_COUNT=10
CONFIG_NET_PKT_TX_COUNT=10

CONFIG_NET_BUF_RX_COUNT=20
CONFIG_NET_BUF_TX_COUNT=20


#USB related configs
CONFIG_USB_DEVICE_STACK=y
CONFIG_USB_DEVICE_PRODUCT="Zephyr MSC sample"
CONFIG_USB_DEVICE_PID=0x0008
CONFIG_USB_DRIVER_LOG_LEVEL_ERR=y
CONFIG_USB_MASS_STORAGE=y
CONFIG_USB_DEVICE_LOG_LEVEL_ERR=y
CONFIG_USB_MASS_STORAGE_LOG_LEVEL_ERR=y
CONFIG_USB_DEVICE_INITIALIZE_AT_BOOT=n

CONFIG_SHELL=y
CONFIG_SHELL_BACKENDS=y
CONFIG_SHELL_LOG_BACKEND=y
CONFIG_SHELL_TAB=y
CONFIG_SHELL_BACKEND_SERIAL_RX_RING_BUFFER_SIZE=128
CONFIG_DISK_DRIVER_FLASH=y
CONFIG_FILE_SYSTEM=y
CONFIG_FILE_SYSTEM_MKFS=y
CONFIG_FAT_FILESYSTEM_ELM=y
CONFIG_FILE_SYSTEM_SHELL=y
CONFIG_DISK_DRIVERS=y
CONFIG_DISK_ACCESS=y
CONFIG_MASS_STORAGE_DISK_NAME="NAND"
CONFIG_FLASH=y
CONFIG_FLASH_MAP=y
CONFIG_FLASH_PAGE_LAYOUT=y
CONFIG_SPI=y
CONFIG_FLASH_STM32_QSPI=y
```

## boards/disco_l475_iot1.overlay
```dts
/ {
	msc_disk0 {
		compatible = "zephyr,flash-disk";
		partition = <&slot2_partition>;
		disk-name = "NAND";
		cache-size = <4096>;
	};
};
```

## src/main.c
```c
#include <stddef.h>
#include <stdint.h>
#include <zephyr/kernel.h>
#include <zephyr/logging/log.h>
#include <zephyr/drivers/rtc.h>
#include "rtc.h"
#include <zephyr/net/socket.h>
#include <zephyr/sys/printk.h>
#include <string.h>
#include "auth.h"
#include <string.h>
#include <stdio.h>
#include "wifi.h"
#include "socket.h"
#include "zephyr/drivers/usb/usb_dc.h"
#include "zephyr/sys/util.h"
#include <stdbool.h>
#include "ferry.h"
#include <zephyr/fs/fs.h>
#include <zephyr/device.h>
#include <zephyr/storage/flash_map.h>
#include <zephyr/usb/usb_device.h>
#include <zephyr/usb/usbd.h>
#include <zephyr/usb/class/usbd_msc.h>
#include <zephyr/storage/disk_access.h>
#include <ff.h>

#define MKFS_FS_TYPE FS_FATFS
#define MKFS_DEV_ID "NAND:"
#define MKFS_FLAGS 0

LOG_MODULE_REGISTER(main, CONFIG_LOG_DEFAULT_LEVEL);
static FATFS fat_fs;


static struct fs_mount_t fat_storage_mnt = {
    .type = FS_FATFS,
    .fs_data = &fat_fs,
    .storage_dev = (void *)"NAND",
    .mnt_point = "/NAND:",
    .flags = MKFS_FLAGS
};


void process_received_packet(char* packet_buf);
void handle_volume_change(void);
void send_volume(int volume);
void receive_ferry_packet(char* packet_buf, size_t packet_buf_size);
void send_arriving(int mmsi);
void send_departing(int mmsi);
void ferry_arriving_action(int mmsi);
void ferry_departing_action(int mmsi);
void fs_init(void);
void mount_fs();
static void usb_status_cb(enum usb_dc_status_code status, const uint8_t *param);
void sync_rtc_with_server(void);
void log_ferry_event(int mmsi, bool arriving);

int current_volume = 100;

struct coordinates UQ_FERRY_TERMINAL = {-27.496776268829635, 153.0195395998301};

/* HTTP get for ferry data */
static const char GET_REQ_FERRY[] =
    "GET /ferry HTTP/1.1\r\n"
    "Host: " SERVER_IP "\r\n"
    "Connection: close\r\n"
    "\r\n";

/* HTTP get for volume change data */
static const char GET_VOL_CHANGE[] =
    "GET /volumechange HTTP/1.1\r\n"
    "Host: " SERVER_IP "\r\n"
    "Connection: close\r\n"
    "\r\n";

/* HTTP get for RTC syncing */
static const char GET_RTC[] =
    "GET /rtc HTTP/1.1\r\n"
    "Host: " SERVER_IP "\r\n"
    "Connection: close\r\n"
    "\r\n";

int main(void) {

    mount_fs();
    usb_enable(usb_status_cb);

    init_rtc();
    setup_wifi();

    sync_rtc_with_server();

    while(1) {
        char packet_buf[512];
        receive_ferry_packet(packet_buf, sizeof(packet_buf));

        process_received_packet(packet_buf);

        k_sleep(K_MSEC(100));
        handle_volume_change();
    }


    while (1) {

        LOG_INF("Hello, World!");

        k_sleep(K_MSEC(30000));

        wifi_status();
    }
    return 0;
}


void receive_ferry_packet(char* packet_buf, size_t packet_buf_size) {
    int sock = connect_to_ip();
    int ret = zsock_send(sock, GET_REQ_FERRY, strlen(GET_REQ_FERRY), 0);
    if (ret < 0) {
        printk("HTTP send failed: %d\n", ret);
        return;
    }
    
    while (true) {
        int rx = zsock_recv(sock, packet_buf, packet_buf_size - 1, 0);
        if (rx > 0) {
            packet_buf[rx] = '\0';
            printk("%s", packet_buf);
        } else if (rx == 0) {
            /* peer closed cleanly */
            break;
        } else {
            printk("HTTP recv error: %d\n", rx);
            break;
        }
    }
    int closeret = zsock_close(sock);
    if (closeret < 0) {
        printk("Socket close error rx ferry: %d\n", closeret);
    }
    printk("\n");
}


void handle_volume_change(void) {
    char packet_buf[128];
    int sock = connect_to_ip();
    int ret = zsock_send(sock, GET_VOL_CHANGE, strlen(GET_VOL_CHANGE), 0);
    if (ret < 0) {
        printk("HTTP send failed: %d\n", ret);
        return;
    }
    
    while (true) {
        int rx = zsock_recv(sock, packet_buf, sizeof(packet_buf) - 1, 0);
        if (rx > 0) {
            packet_buf[rx] = '\0';
            printk("%s", packet_buf);
        } else if (rx == 0) {
            /* peer closed cleanly */
            break;
        } else {
            printk("HTTP recv error: %d\n", rx);
            break;
        }
    }
    int closeret = zsock_close(sock);
    if (closeret < 0) {
        printk("Socket close error handle volume change: %d\n", closeret);
    }
    printk("\n");

    // process packet
    int status, change;
    if (sscanf(packet_buf, "{\"status\":%d,\"change\":%d", &status, &change) == 2) {
        printk("parsed: status=%d, change=%dn", status, change);

        if (change == -1 || status == 404) return;   // no change required

        if (change == 0) {
            // decrease volume
            current_volume = MAX(0, current_volume - 10);
        } else {
            // increase volume
            current_volume = MIN(255, current_volume + 10);
        }

        // send change back
        send_volume(current_volume);
    } else {
        printk("JSON parse failed for volume change\n");
    }
}

void sync_rtc_with_server(void) {
    char packet_buf[128];
    int sock = connect_to_ip();
    int ret = zsock_send(sock, GET_RTC, strlen(GET_RTC), 0);
    if (ret < 0) {
        printk("HTTP send failed: %d\n", ret);
        return;
    }
    
    while (true) {
        int rx = zsock_recv(sock, packet_buf, sizeof(packet_buf) - 1, 0);
        if (rx > 0) {
            packet_buf[rx] = '\0';
            printk("%s", packet_buf);
        } else if (rx == 0) {
            /* peer closed cleanly */
            break;
        } else {
            printk("HTTP recv error: %d\n", rx);
            break;
        }
    }
    int closeret = zsock_close(sock);
    if (closeret < 0) {
        printk("Socket close error handle volume change: %d\n", closeret);
    }
    printk("\n");

    // process packet
    int year, mon, day, hour, min, sec;
    if (sscanf(packet_buf, "{\"year\":%d,\"mon\":%d,\"day\":%d,\"hour\":%d,\"min\":%d,\"sec\":%d", &year, &mon, &day, &hour, &min, &sec) == 6) {
        printk("parsed time: %d %d %d %d %d %d\n", year, mon, day, hour, min, sec);;

        struct rtc_time set_time = {
            .tm_year = year - 1900,  // Year since 1900
            .tm_mon = mon - 1,         // Month (0-based)
            .tm_mday = day,           // Day
            .tm_hour = hour,           // Hour
            .tm_min = min,            // Minute
            .tm_sec = sec              // Second
        };
        set_rtc_time(&set_time);

    } else {
        printk("JSON parse failed for RTC sync\n");
    }
}


void process_received_packet(char* packet_buf) {
    double lat, lon;
    int status;
    int32_t mmsi;
    if (sscanf(packet_buf,
           "{\"status\":%d,\"mmsi\":%d,\"lat\":%lf,\"lon\":%lf",
           &status, &mmsi, &lat, &lon) == 4) {
        printk("parsed: status=%d, mmsi=%d, lat=%f, lon=%f\n", status, mmsi, lat, lon);

        if (status == 404) return;
        
        struct coordinates ferryCoords = {lat, lon};
        // attempt to get ferry
        struct ferry *existing_ferry = get_ferry_by_mmsi(mmsi);
        if (existing_ferry == NULL) {
            // add new ferry
            double dist = distance_between_coords(ferryCoords, UQ_FERRY_TERMINAL);
            bool near = dist < 100;
            struct ferry new_ferry = {mmsi, near, ferryCoords};
            track_new_ferry(new_ferry);
            if (near) {
                // new ferry is near terminal
                ferry_arriving_action(mmsi);
            }
        } else{
            // update existing ferry coords
            existing_ferry->coords.lat = lat;
            existing_ferry->coords.lon = lon;

            bool near = is_ferry_near_coords(*existing_ferry, UQ_FERRY_TERMINAL);
            if (near && !existing_ferry->near_terminal) {
                // This means that an existing ferry has now moved close to a terminal and it wasn't before
                ferry_arriving_action(mmsi);
            } else if (!near && existing_ferry->near_terminal) {
                // existing ferry has moved away from a terminal
                ferry_departing_action(mmsi);
            }
            existing_ferry->near_terminal = near;
        }
    } else {
        printk("JSON parse failed\n");
    }
}


void send_post(char* endpoint, char* body) {
    char msg[256];

    int len = snprintf(msg, sizeof(msg), 
        "POST /%s HTTP/1.1\r\n"
        "Host: " SERVER_IP "\r\n"
        "Content-Type: application/json\r\n"
        "Content-Length: %u\r\n"
        "Connection: close\r\n"
        "\r\n"
        "%s",
        endpoint,
        (unsigned)strlen(body),
        body);

    if (len < 0 || len >= sizeof(msg)) {
        printk("Can't format packet\n");
        return;
    }

    int sock = connect_to_ip();
    int ret = zsock_send(sock, msg, len, 0);

    if (ret < 0) {
        printk("HTTP POST send failed: %d\n", ret);
        return;
    }
    int closeret = zsock_close(sock);
    if (closeret < 0) {
        printk("Socket close error send post: %d\n", closeret);
    }
}

void send_volume(int volume) {
    char body[64];
    snprintf(body, sizeof(body), "{\"volume\":\"%d\"}", volume);

    send_post("volume", body);
}


void send_arriving(int mmsi) {
    char body[64];
    snprintf(body, sizeof(body), "{\"mmsi\":\"%d\"}", mmsi);

    send_post("arriving", body);
}


void send_departing(int mmsi) {
    char body[64];
    snprintf(body, sizeof(body), "{\"mmsi\":\"%d\"}", mmsi);

    send_post("departing", body);
}


void ferry_arriving_action(int mmsi) {
    printk("Ferry %d has arrived at terminal\n", mmsi);
    // send update to webserver
    send_arriving(mmsi);
    log_ferry_event(mmsi, true);
}

void ferry_departing_action(int mmsi) {
    printk("Ferry %d has left terminal\n", mmsi);
    // send update to webserver
    send_departing(mmsi);
    log_ferry_event(mmsi, false);
}


void fs_init(void) {
    int rc = fs_mkfs(MKFS_FS_TYPE, (uintptr_t)MKFS_DEV_ID, NULL, MKFS_FLAGS);
    if (rc != 0) {
        printk("FS MKFS Failed: %d\n", rc);
    } else {
        printk("FS MKFS Success\n");
    }
}

/**
 * Mounts the file system
 */
void mount_fs() {

    int rc;
    rc = fs_mount(&fat_storage_mnt);

    if (rc != 0) {
        printk("Failed to mount FS: %d\n", rc);
    }

}


static void usb_status_cb(enum usb_dc_status_code status, const uint8_t *param)
{
    printk("USB status: %d\n", status);
    switch (status) {
    case USB_DC_CONFIGURED:
        printk("USB CONNECTED\n");
        break;

    case USB_DC_DISCONNECTED:
    case USB_DC_SUSPEND:
        printk("USB DISCONNECTED/SUSPENDED\n");
        break;

    default:
        break;
    }
}


void log_ferry_event(int mmsi, bool arriving) {
    // generate line to write
    char entry_buf[128];
    char formatted_time[32];
    format_rtc_time(formatted_time, sizeof(formatted_time));

    char *status;
    if (arriving) {
        status = "ARRIVING at";
    } else {
        status = "DEPARTING from";
    }

    snprintf(entry_buf, sizeof(entry_buf), "%s: MMSI %d is %s terminal.", formatted_time, mmsi, status);

    int rc;
    struct fs_file_t file;
    fs_file_t_init(&file);
    // open file in append mode
    rc = fs_open(&file, "/NAND:/FERRYLOG.txt", FS_O_CREATE | FS_O_WRITE | FS_O_APPEND);
    fs_write(&file, entry_buf, strlen(entry_buf));
    fs_write(&file, "\n", 1);
    fs_close(&file);
}
```

## src/ferry.c
```c
#include "ferry.h"
#include "math.h"
#include <stdbool.h>

#define PI 3.14159265358979323846

struct ferry tracked_ferries[5];
int num_ferries = 0;

static double deg2rad(double deg) {
    return deg * (PI / 180.0);
}

double haversine_distance(double lat1, double lon1,
                          double lat2, double lon2) {
    const double R = 6371000.0;  // Earth radius in meters

    double phi1 = deg2rad(lat1);
    double phi2 = deg2rad(lat2);
    double deltaphi = deg2rad(lat2 - lat1);
    double deltalambda = deg2rad(lon2 - lon1);

    double a = sin(deltaphi/2) * sin(deltaphi/2)
             + cos(phi1) * cos(phi2)
             * sin(deltalambda/2) * sin(deltalambda/2);
    double c = 2 * atan2(sqrt(a), sqrt(1 - a));

    return R * c;
}

double distance_between_coords(struct coordinates coords1, struct coordinates coords2) {
    return haversine_distance(coords1.lat, coords1.lon, coords2.lat, coords2.lon);
}

bool is_ferry_near_coords(struct ferry ferry, struct coordinates coords) {

    return distance_between_coords(ferry.coords, coords) < 100;

}

struct ferry *get_ferry_by_mmsi(int mmsi) {
    for (int i = 0; i < 5; i++) {
        if (tracked_ferries[i].mmsi == mmsi) {
            return &tracked_ferries[i];
        }
    }
    return NULL;
}

void track_new_ferry(struct ferry ferry) {
    if (num_ferries == 4) return;
    num_ferries++;
    tracked_ferries[num_ferries] = ferry;
}
```

## src/ferry.h
```c
#ifndef FERRY_H_
#define FERRY_H_

#include <stdbool.h>

struct coordinates {
    double lat;
    double lon;
};

struct ferry {
    int mmsi;
    bool near_terminal;
    struct coordinates coords;
};

extern struct ferry tracked_ferries[5];

struct ferry *get_ferry_by_mmsi(int mmsi);
void track_new_ferry(struct ferry ferry);
bool is_ferry_near_coords(struct ferry ferry, struct coordinates coords);
double distance_between_coords(struct coordinates coords1, struct coordinates coords2);

#endif
```

## src/rtc.c
```c
#include <stdio.h>
#include <zephyr/device.h>
#include <zephyr/logging/log.h>
#include <zephyr/drivers/rtc.h>

#include "rtc.h"

#define RTC_NODE DT_NODELABEL(rtc)

LOG_MODULE_REGISTER(rtc_module, LOG_LEVEL_DBG);

const struct device *rtc_dev;

// setup RTC mutex
K_MUTEX_DEFINE(rtc_mutex);

/**
 * Set the RTC time
 * 
 * @param time Pointer to the rtc_time structure containing the time to set
 */
void set_rtc_time(struct rtc_time *time) {
    k_mutex_lock(&rtc_mutex, K_FOREVER);
    rtc_set_time(rtc_dev, time);
    k_mutex_unlock(&rtc_mutex);
    LOG_INF("RTC time set to: %04d-%02d-%02d %02d:%02d:%02d\n",
        time->tm_year + 1900,
        time->tm_mon + 1,
        time->tm_mday,
        time->tm_hour,
        time->tm_min,
        time->tm_sec
    );
}

/**
 * Get the current RTC time
 * 
 * @param time Pointer to the rtc_time structure to store the current time
 */
void get_rtc_time(struct rtc_time *time) {
    k_mutex_lock(&rtc_mutex, K_FOREVER);
    rtc_get_time(rtc_dev, time);
    k_mutex_unlock(&rtc_mutex);
}

/**
 * Initialise the RTC device and set an initial time
 */
void init_rtc(void) {
    // init RTC device
    rtc_dev = DEVICE_DT_GET(RTC_NODE);
    // set initial time
    struct rtc_time set_time = {
        .tm_year = 2025 - 1900,  // Year since 1900
        .tm_mon = 5 - 1,         // Month (0-based)
        .tm_mday = 22,           // Day
        .tm_hour = 0,           // Hour
        .tm_min = 0,            // Minute
        .tm_sec = 0              // Second
    };
    set_rtc_time(&set_time);
    LOG_DBG("RTC initialised");
}


void format_rtc_time(char *buf, size_t maxlen) {
    struct rtc_time time;
    get_rtc_time(&time);
    snprintf(buf, maxlen, "%04d-%02d-%02d %02d:%02d:%02d",
        time.tm_year + 1900,
        time.tm_mon + 1,
        time.tm_mday,
        time.tm_hour,
        time.tm_min,
        time.tm_sec
    );
}
```

## src/rtc.h
```c
#ifndef RTC_H
#define RTC_H
#include <zephyr/drivers/rtc.h>

void init_rtc(void);
void set_rtc_time(struct rtc_time *time);
void get_rtc_time(struct rtc_time *time);
void format_rtc_time(char *buf, size_t maxlen);

#endif // RTC_H
```

## src/socket.c
```c
#include <zephyr/net/socket.h>
#include <zephyr/sys/printk.h>

#include "socket.h"

#include "auth.h"


int connect_to_ip(void) {
    // create socket
    int sock = zsock_socket(AF_INET, SOCK_STREAM, IPPROTO_TCP);
    if (sock < 0) {
        printk("Socket creation failed: %d\n", sock);
        return -1;
    }
    struct timeval tv = { .tv_sec = 5, .tv_usec = 0 };
    zsock_setsockopt(sock, SOL_SOCKET, SO_RCVTIMEO, &tv, sizeof(tv));
    zsock_setsockopt(sock, SOL_SOCKET, SO_SNDTIMEO, &tv, sizeof(tv));

    // generate address info
    struct sockaddr_in addr = {
        .sin_family = AF_INET,
        .sin_port = htons(SERVER_PORT),
    };

    if (zsock_inet_pton(AF_INET, SERVER_IP, &addr.sin_addr) != 1) {
        printk("inet_pton failed\n");
        zsock_close(sock);
        return -1;
    }

    printk("Connecting to %s:%u… ", SERVER_IP, SERVER_PORT);

    int ret = zsock_connect(sock, (struct sockaddr*)&addr, sizeof(addr));
    if (ret) {
        printk("Failed to connect: %d\n", ret);
        zsock_close(sock);
        return -1;
    }

    printk("Successfully connected to socket!\n");
    return sock;
}
```

## src/socket.h
```c
#ifndef SOCKET_H_
#define SOCKET_H_

int connect_to_ip(void);

#endif
```

## src/wifi.c
```c
#include <zephyr/net/wifi_mgmt.h>
#include <zephyr/net/net_mgmt.h>
#include <zephyr/net/net_event.h>
#include <zephyr/net/net_if.h>

#include "wifi.h"

#include "auth.h"
#include "zephyr/kernel.h"

static int connect_wifi(void);

/** Semaphore to indicate when wifi successfully connected */
K_SEM_DEFINE(wifi_sem, 0, 1);

static struct net_mgmt_event_callback wifi_cb;


static void wifi_event_handler(struct net_mgmt_event_callback *cb, uint32_t mgmt_event, struct net_if *iface) {
    if (mgmt_event == NET_EVENT_IPV4_ADDR_ADD) {
        printk("WiFi connected!\n");
        k_sem_give(&wifi_sem);
    }
}


void wifi_status(void)
{
    struct net_if *iface = net_if_get_default();
    
    struct wifi_iface_status status = {0};

    if (net_mgmt(NET_REQUEST_WIFI_IFACE_STATUS, iface, &status,	sizeof(struct wifi_iface_status)))
    {
        printk("WiFi Status Request Failed\n");
    }

    printk("\n");

    if (status.state >= WIFI_STATE_ASSOCIATED) {
        printk("SSID: %-32s\n", status.ssid);
        printk("Band: %s\n", wifi_band_txt(status.band));
        printk("Channel: %d\n", status.channel);
        printk("Security: %s\n", wifi_security_txt(status.security));
        printk("RSSI: %d\n", status.rssi);
    }
}


void setup_wifi(void) {
    net_mgmt_init_event_callback(&wifi_cb, wifi_event_handler, NET_EVENT_IPV4_ADDR_ADD);
    net_mgmt_add_event_callback(&wifi_cb);

    connect_wifi();

    k_sem_take(&wifi_sem, K_FOREVER);
}


static int connect_wifi(void) {
    
    static struct wifi_connect_req_params params;
    
    struct net_if *iface = net_if_get_default();
    printk("Setting up connection\n");
    if (!iface) {
        printk("No default network interface available\n");
        return -1;
    }

    printk("Attempting to connect to %s\n", WIFI_ID);
    params.ssid = WIFI_ID;
    params.ssid_length = strlen(WIFI_ID);
    params.psk = WIFI_PASSWORD;
    params.psk_length = strlen(WIFI_PASSWORD);
    params.channel = WIFI_CHANNEL_ANY;
    params.security = WIFI_SECURITY_TYPE_PSK;
    params.mfp = WIFI_MFP_OPTIONAL;
    params.band = WIFI_FREQ_BAND_UNKNOWN;
    int ret = net_mgmt(NET_REQUEST_WIFI_CONNECT, iface, &params, sizeof(params));
    if (ret) {
        printk("WiFi connection request failed: %d\n", ret);
        return ret;
    }
    return 0;
}
```

## src/wifi.h
```c
#ifndef WIFI_H_
#define WIFI_H_

void setup_wifi(void);
void wifi_status(void);

#endif
```
