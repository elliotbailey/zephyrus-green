## CMakeLists.txt
```
# SPDX-License-Identifier: Apache-2.0

cmake_minimum_required(VERSION 3.20.0)

find_package(Zephyr REQUIRED HINTS $ENV{ZEPHYR_BASE})
project(ml_ultrasonic)

#enable_language(CXX)

set(NO_THREADSAFE_STATICS $<TARGET_PROPERTY:compiler-cpp,no_threadsafe_statics>)
zephyr_compile_options($<$<COMPILE_LANGUAGE:CXX>:${NO_THREADSAFE_STATICS}>)

file(GLOB app_sources src/*)
target_sources(app PRIVATE ${app_sources})

target_include_directories(app PRIVATE include)
```

## prj.conf
```kconfig
CONFIG_GPIO=y

CONFIG_TIMING_FUNCTIONS=y
CONFIG_CBPRINTF_FP_SUPPORT=y

CONFIG_LOG=y
CONFIG_HEAP_MEM_POOL_SIZE=65536
CONFIG_MAIN_STACK_SIZE=16384

# C++
CONFIG_CPP=y
CONFIG_STD_CPP17=y
CONFIG_TENSORFLOW_LITE_MICRO=y
```

## src/main.c
```c
#include "main_functions.h"

int main(int argc, char *argv[])
{
	setup();
	while(1) {
		loop();
	}
	return 0;
}
```

## include/main_functions.h
```c
#ifndef ULTRASONIC_MAIN_FUNCTIONS_H_
#define ULTRASONIC_MAIN_FUNCTIONS_H_

#ifdef __cplusplus
extern "C" {
#endif

    void setup(void);
    void loop(void);

#ifdef __cplusplus
}
#endif

#endif
```

## include/ul_model_data.h
```c
#ifndef UL_MODEL_DATA_H_
#define UL_MODEL_DATA_H_

#ifdef __cplusplus
extern "C" {
#endif

extern const unsigned char model_tflite[];
extern unsigned int model_tflite_len;

#ifdef __cplusplus
}
#endif

#endif
```

## include/ultrasonic_handler.h
```c
#ifndef ML_ULTRASONIC
#define ML_ULTRASONIC

#ifdef __cplusplus
extern "C" {
#endif
    
    void ultrasonic_init(void);           
    float ultrasonic_read(void);
    void ultrasonic_publish(int category);

#ifdef __cplusplus
}
#endif

#endif
```

## src/main_functions.cpp
```c
#include "main_functions.h"
#include "ul_model_data.h"
#include "ultrasonic_handler.h"
#include <tensorflow/lite/micro/micro_log.h>
#include <tensorflow/lite/micro/micro_interpreter.h>
#include <tensorflow/lite/micro/micro_mutable_op_resolver.h>
#include <tensorflow/lite/schema/schema_generated.h>

/* Globals, used for compatibility with Arduino-style sketches. */
namespace {
	const tflite::Model *model = nullptr;
	tflite::MicroInterpreter *interpreter = nullptr;
	TfLiteTensor *model_input = nullptr;
	int input_length;

	/* Create an area of memory to use for input, output, and intermediate arrays.
	* The size of this will depend on the model you're using, and may need to be
	* determined by experimentation.
	*/
	constexpr int kTensorArenaSize = 20 * 1024;
	uint8_t tensor_arena[kTensorArenaSize];
} /* namespace */

/* The name of this function is important for Arduino compatibility. */
void setup(void)
{
	/* Map the model into a usable data structure. This doesn't involve any
	 * copying or parsing, it's a very lightweight operation.
	 */
	 
	model = tflite::GetModel(model_tflite);
	if (model->version() != TFLITE_SCHEMA_VERSION) {
		printf("Model provided is schema version %d not equal "
				    "to supported version %d.",
				    model->version(), TFLITE_SCHEMA_VERSION);
		return;
	}

	/* Pull in only the operation implementations we need.
	 * This relies on a complete list of all the ops needed by this graph.
	 * An easier approach is to just use the AllOpsResolver, but this will
	 * incur some penalty in code space for op implementations that are not
	 * needed by this graph.
	 */
	
	static tflite::MicroMutableOpResolver < 10 > micro_op_resolver; /* NOLINT */
	micro_op_resolver.AddConv2D();
	micro_op_resolver.AddRelu();
	micro_op_resolver.AddFullyConnected();
	micro_op_resolver.AddSoftmax();
	micro_op_resolver.AddReshape();
	micro_op_resolver.AddQuantize();
	micro_op_resolver.AddDequantize();
	micro_op_resolver.AddExpandDims();

	/* Build an interpreter to run the model with. */
	static tflite::MicroInterpreter static_interpreter(
		model, micro_op_resolver, tensor_arena, kTensorArenaSize);
	interpreter = &static_interpreter;

	/* Allocate memory from the tensor_arena for the model's tensors. */
	interpreter->AllocateTensors();

	/* Obtain pointer to the model's input tensor. */
	model_input = interpreter->input(0);
	if (!model_input) {
    	printf("model_input is NULL\n");
    	return;
	}
	if ((model_input->dims->size != 3) ||
	    (model_input->dims->data[0] != 1) ||
	    (model_input->dims->data[1] != 30) ||
        (model_input->dims->data[2] != 3) ||
	    (model_input->type != kTfLiteUInt8)) {
		printf("model_input->type = %d (expected %d)\n", model_input->type, kTfLiteUInt8);
		printf("Bad input tensor parameters in model\n");
		for (int i = 0; i < model_input->dims->size; i++) {
    		printf("%d ", model_input->dims->data[i]);
		}
		return;
	}

	input_length = model_input->bytes / sizeof(int8_t);
	
	ultrasonic_init();
}

void loop(void)
{
    static float ul_buff[30];
    static int ref_index = 0;
	
	ul_buff[ref_index++] = ultrasonic_read();
	//printf("%f\n", ul_buff[ref_index - 1]);

	//printf("%d, %f\n", ref_index - 1, ul_buff[ref_index - 1]);
	
    if (ref_index < 30) {
        // Needs more sampling to complete the time series
        return;
    }

    // Full time series collected
    ref_index = 0;

	// Calculate necessary information from time series
	static float vel[30];
	for (int i = 0; i < 29; i++) {
		vel[i] = ul_buff[i + 1] - ul_buff[i];
	}
	vel[29] = vel[28];
	static float accel[30];
	for (int i = 0; i < 28; i++) {
		accel[i] = vel[i + 1] - vel[i];
	}
	accel[28] = accel[27];
	accel[29] = accel[28];
	
    // Quantisation
    for (int i = 0; i < 30; i++) {
        int32_t quantized_value = static_cast<int32_t>(round(ul_buff[i] / model_input->params.scale) + model_input->params.zero_point);
        // Clip Quantised Values
        quantized_value = std::max(-128, quantized_value);
        quantized_value = std::min(127, quantized_value);
        model_input->data.int8[i] = static_cast<int8_t>(quantized_value);

		quantized_value = static_cast<int32_t>(round(vel[i] / model_input->params.scale) + model_input->params.zero_point);
        // Clip Quantised Values
        quantized_value = std::max(-128, quantized_value);
        quantized_value = std::min(127, quantized_value);
        model_input->data.int8[i + 30] = static_cast<int8_t>(quantized_value);

		quantized_value = static_cast<int32_t>(round(accel[i] / model_input->params.scale) + model_input->params.zero_point);
        // Clip Quantised Values
        quantized_value = std::max(-128, quantized_value);
        quantized_value = std::min(127, quantized_value);
        model_input->data.int8[i + 60] = static_cast<int8_t>(quantized_value);
    }
	

	/* Run inference, and report any error */
	
	TfLiteStatus invoke_status = interpreter->Invoke();
	if (invoke_status != kTfLiteOk) {
		printf("Invoke failed on index: %d\n", ref_index);
		return;
	}
	TfLiteTensor* output = interpreter->output(0);
	int8_t* quantized_prob_dist = output->data.int8;
	float dequantized_prob_dist[3] = {0};
    int max_likelihood_index = 0;
	//printf("Zero Point: %d\n", output->params.zero_point);
	//printf("Scale: %f\n", output->params.scale);
	for (int i = 0; i < 3; i++) {
		dequantized_prob_dist[i] = output->params.scale * (quantized_prob_dist[i] - output->params.zero_point);
		//printf("Prob-Dist: %d, %d, %f\n", i, quantized_prob_dist[i], dequantized_prob_dist[i]);
	}
    for (int i = 0; i < 3; i++) {
        if ((dequantized_prob_dist[i] > dequantized_prob_dist[max_likelihood_index]) && i != 2) {
            max_likelihood_index = i;
        }
		//printf("Prob-Dist: %d, %d\n", i, quantized_prob_dist[i]);
		
    }
    
    int selected_category = max_likelihood_index + 1;
	if (quantized_prob_dist[2] > 2) {
		selected_category = 3;
	} else if (quantized_prob_dist[1] > -6) {
		selected_category = 2;
	} else {
		selected_category = 1;
	}
	//printf("selected=%d\n", selected_category);
	ultrasonic_publish(selected_category);
	if (selected_category == 1) {
        // Swipe down towards
        printf("Lower Volume\n");
    } else if (selected_category == 2) {
        // Swipe up away
        printf("Higher Volume\n");
    } else if (selected_category == 3) {
        // Swipe across
        printf("No Gesture Detected ...\n");
    }
    // Else remain IDLE
}
```

## src/ultrasonic_handler.c
```c
#include <zephyr/kernel.h>
#include <zephyr/device.h>
#include <zephyr/sys/util.h>
#include <zephyr/drivers/gpio.h>
#include <zephyr/drivers/timer/system_timer.h>
#include <zephyr/sys/time_units.h>
#include <stdlib.h>
#include <math.h>
#include "ultrasonic_handler.h"


//static const struct device *trig_port = DEVICE_DT_GET(DT_NODELABEL(gpio0)); // ESP32
//static const struct device *echo_port = DEVICE_DT_GET(DT_NODELABEL(gpio0));
static const struct device *trig_port = DEVICE_DT_GET(DT_NODELABEL(gpiob)); // Nucleo (For sampling)
static const struct device *echo_port = DEVICE_DT_GET(DT_NODELABEL(gpiob));
static const struct device *mqtt_port = DEVICE_DT_GET(DT_NODELABEL(gpioa));
static struct gpio_callback pulse_info;

uint32_t pulse_start_time;
uint32_t pulse_duration;
uint8_t pulse_active = 0;

static void pulse_callback(const struct device *dev, struct gpio_callback *callback, uint32_t pin) {
    if (pulse_active) {
        pulse_duration = k_cyc_to_us_floor32(k_cycle_get_32()) - pulse_start_time;
        pulse_active = 0;
    } else {
        pulse_start_time = k_cyc_to_us_floor32(k_cycle_get_32());
        //printf("Pulse started\n");
        pulse_active = 1;
    }
}

void ultrasonic_init(void) {
    //gpio_pin_configure(trig_port, 5, GPIO_OUTPUT);
    //gpio_pin_configure(echo_port, 4, GPIO_INPUT);
    //gpio_pin_interrupt_configure(echo_port, 4, GPIO_INT_EDGE_BOTH);
    //gpio_init_callback(&pulse_info, pulse_callback, 1 << 4);
    gpio_pin_configure(trig_port, 9, GPIO_OUTPUT);
    gpio_pin_configure(echo_port, 8, GPIO_INPUT);
    gpio_pin_interrupt_configure(echo_port, 8, GPIO_INT_EDGE_BOTH);
    gpio_init_callback(&pulse_info, pulse_callback, 1 << 8);
    gpio_add_callback(echo_port, &pulse_info);
    gpio_pin_configure(mqtt_port, 5, GPIO_OUTPUT);
    gpio_pin_configure(mqtt_port, 6, GPIO_OUTPUT);
    gpio_pin_configure(mqtt_port, 7, GPIO_OUTPUT);
    gpio_pin_set(mqtt_port, 5, 0);
    gpio_pin_set(mqtt_port, 6, 0);
    gpio_pin_set(mqtt_port, 7, 0);
}

float ultrasonic_read(void) {
    //gpio_pin_set(trig_port, 5, 1);
    gpio_pin_set(trig_port, 9, 1);
    k_busy_wait(10);
    //gpio_pin_set(trig_port, 5, 0);
    gpio_pin_set(trig_port, 9, 0);
    k_msleep(50);
    // Speed of sound assumed
    //printf("Duration=%d\n", pulse_duration);
    return fmin(((pulse_duration / 1000000.0f) * 343.0f / 2.0f), 3.00);
}

void ultrasonic_publish(int category) {
    //printf("Category %d\n", category);
    
    if (category == 1) {
        gpio_pin_toggle(mqtt_port, 5);
        //int pin_state = gpio_pin_get_raw(mqtt_port, 5);
        //printf("Pin state before wait: %d\n", pin_state);
        k_msleep(500);
    } else if (category == 2) {
        gpio_pin_toggle(mqtt_port, 6);
        k_msleep(500);
    } else if (category == 3) {
        //gpio_pin_toggle(mqtt_port, 7);
        //k_msleep(500);
    }
    
    //gpio_pin_toggle(mqtt_port, 5);
    k_msleep(500);
}
```
